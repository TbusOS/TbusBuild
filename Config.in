## Config.in
```kconfig
menu "platform"
    config EXTERNEL_LINUX_DIR
        string "externel linux kernel dir"

    source "$BR2_EXTERNAL_TBUS_BUILD_PATH/platform/app/package/Config.in"
    source "$BR2_EXTERNAL_TBUS_BUILD_PATH/platform/driver/package/Config.in"
    source "$BR2_EXTERNAL_TBUS_BUILD_PATH/platform/tools/package/Config.in"

    source "$BR2_EXTERNAL_TBUS_BUILD_PATH/platform/driver/package/hello_world/Config.in"
    source "$BR2_EXTERNAL_TBUS_BUILD_PATH/platform/app/package/demo/Config.in"
endmenu
```

## platform/app/package/Config.in
```kconfig
config BR2_SELECT_ALL_APP
    bool "select all app"
    default n
    select BR2_PACKAGE_APP_DEMO
```

## platform/driver/package/Config.in
```kconfig
config BR2_SELECT_ALL_DRIVER
    bool "select all driver"
    default n
    select BR2_PACKAGE_DRIVER_HELLO_WORLD
```
